## main/Kconfig.projbuild
```kconfig
menu "DWC Keeper Configuration"

    menu "WiFi Configuration"
        config WIFI_TASK_STACK_SIZE
            int "WiFi Task Stack Size"
            default 4096
            help
                Stack size for WiFi task in bytes.

        config WIFI_TASK_PRIORITY
            int "WiFi Task Priority"
            default 3
            help
                Priority for WiFi task.

        config WIFI_STATIC_IP
            string "Static IP Address"
            default "192.168.1.32"
            help
                Static IP address for the device.

        config WIFI_GATEWAY
            string "Gateway Address"
            default "192.168.1.1"
            help
                Gateway IP address for the network.

        config WIFI_NETMASK
            string "Netmask"
            default "255.255.255.0"
            help
                Network mask for the static IP configuration.

        config WIFI_DNS_MAIN
            string "Primary DNS Server"
            default "8.8.8.8"
            help
                Primary DNS server address.

        config WIFI_DNS_BACKUP
            string "Secondary DNS Server"
            default "8.8.4.4"
            help
                Secondary DNS server address.
    endmenu

    menu "OTA Configuration"
        config OTA_TIMEOUT_MS
            int "OTA Timeout (ms)"
            default 10000
            help
                Timeout for OTA operations in milliseconds.

        config OTA_TASK_STACK_SIZE
            int "OTA Task Stack Size"
            default 8192
            help
                Stack size for OTA task in bytes.

        config OTA_TASK_PRIORITY
            int "OTA Task Priority"
            default 5
            help
                Priority for OTA task.
        
        config OTA_PAYLOAD_URL
            string "OTA Payload URL"
            default "https://192.168.1.150:8080/dwc_keeper.bin"
            help
                URL to the OTA payload.

        config OTA_RESTART_DELAY_MS
            int "OTA Restart Delay (ms)"
            default 1000
            help
                Delay in milliseconds before restarting after successful OTA update.
    endmenu

    menu "Logger Configuration"
        config LOG_BUFFER_SIZE_BYTES
            int "Log Buffer Size (bytes)"
            default 16384
            help
                Size of the ring buffer for storing log messages in bytes.
        
        config LOG_STACK_BUFFER_SIZE_BYTES
            int "Log Stack Buffer Size (bytes)"
            default 2048
            help
                Size of the stack buffer for vprintf.

        config LOG_MAX_SOCKETS
            int "Maximum Log Sockets"
            default 3
            help
                Maximum number of sockets that can receive log streams simultaneously.

        config LOG_SEND_TASK_STACK_SIZE
            int "Log Send Task Stack Size"
            default 4096
            help
                Stack size for the log sending task in bytes.

        config LOG_SEND_TASK_PRIORITY
            int "Log Send Task Priority"
            default 0
            help
                Priority for the log sending task.

        config LOG_PRINT_STATS_TASK_STACK_SIZE
            int "Log Print Stats Task Stack Size"
            default 2048
            help
                Stack size for the log print stats task in bytes.

        config LOG_PRINT_STATS_TASK_PRIORITY
            int "Log Print Stats Task Priority"
            default 0
            help
                Priority for failed allocations and sends log print stats task.

        config LOG_PRINT_STATS_INTERVAL_MS
            int "Log Print Stats Interval (ms)"
            default 30000
            help
                Interval between failed allocations and sends log print stats in milliseconds.
    endmenu

    menu "Server Configuration"
        config MAX_ASYNC_REQUESTS
            int "Maximum Async Requests"
            default 5
            help
                Maximum number of async HTTP requests that can be handled simultaneously.

        config HTTP_MAX_OPEN_SOCKETS
            int "Maximum Open HTTP Sockets"
            default 5
            help
                Maximum number of HTTP sockets that can be open simultaneously.
    endmenu

    menu "Heap Monitor Configuration"
        config HEAP_MONITOR_INTERVAL_MS
            int "Heap Monitor Interval (ms)"
            default 10000
            help
                Interval between heap status reports in milliseconds.

        config HEAP_MONITOR_TASK_STACK_SIZE
            int "Heap Monitor Task Stack Size"
            default 2048
            help
                Stack size for the heap monitor task in bytes.

        config HEAP_MONITOR_TASK_PRIORITY
            int "Heap Monitor Task Priority"
            default 0
            help
                Priority for the heap monitor task.
    endmenu

    menu "Input Configuration"
        config INPUT_BUTTON_GPIO_NUM
            int "Button GPIO Number"
            default 34
            help
                GPIO pin number for the input button.

        config INPUT_BUTTON_DEBOUNCE_MS
            int "Button Debounce Time (ms)"
            default 50
            help
                Button debounce time in milliseconds.

        config INPUT_ENCODER_GLITCH_FILTER_MAX_NS
            int "Encoder Glitch Filter Maximum (ns)"
            default 1000
            help
                Maximum nanoseconds for encoder glitch filter.

        config INPUT_ENCODER_STEP_SIZE
            int "Encoder Step Size"
            default 2
            help
                Step size for encoder rotation detection.

        config INPUT_ENCODER_CLK_GPIO_NUM
            int "Encoder Clock GPIO Number"
            default 36
            help
                GPIO pin number for encoder clock signal.

        config INPUT_ENCODER_DATA_GPIO_NUM
            int "Encoder Data GPIO Number"
            default 39
            help
                GPIO pin number for encoder data signal.

        config INPUT_PCNT_QUEUE_SIZE
            int "Pulse Counter Queue Size"
            default 10
            help
                Size of the pulse counter event queue.
    endmenu

    menu "LCD Configuration"
        config LCD_LINES
            int "LCD Lines"
            default 2
            help
                Number of lines on the LCD display.

        config LCD_RS_PIN
            int "LCD RS Pin"
            default 27
            help
                GPIO pin number for LCD RS (Register Select) signal.

        config LCD_RW_PIN
            int "LCD RW Pin"
            default 26
            help
                GPIO pin number for LCD RW (Read/Write) signal.

        config LCD_E_PIN
            int "LCD Enable Pin"
            default 25
            help
                GPIO pin number for LCD Enable signal.

        config LCD_D4_PIN
            int "LCD D4 Pin"
            default 33
            help
                GPIO pin number for LCD D4 data line.

        config LCD_D5_PIN
            int "LCD D5 Pin"
            default 32
            help
                GPIO pin number for LCD D5 data line.

        config LCD_D6_PIN
            int "LCD D6 Pin"
            default 13
            help
                GPIO pin number for LCD D6 data line.

        config LCD_D7_PIN
            int "LCD D7 Pin"
            default 14
            help
                GPIO pin number for LCD D7 data line.
    endmenu

    menu "Timer Configuration"
        config TIMER_RESOLUTION_HZ
            int "Timer Resolution (Hz)"
            default 1000000
            help
                Timer resolution in Hz for button debounce timer.
    endmenu

endmenu
```
